## arch/arm/mach-tz3000/Kconfig
```kconfig
menu "TOSHIBA TZ3000 platform"
	depends on ARCH_TZ3000

config MACH_TZ3000RB
	bool "Support TOSHIBA TZ3000 RB board"
	default y
	help
	  Include support for TOSHIBA RBTZ3000 (ANDES) board.
	  This board has UART, SD slot, SDIO slot, SPIB with two
	  embedded SPI-Flash chip, I2C, NAND socket, PCIe slot, USBH,
	  Gbit-Ether, etc.

config MACH_TZ3000RB2
	bool "Support TOSHIBA TZ3000 RB2 platform"
	default y
	help
	  Include support for TOSHIBA RBTZ3000 (URAL) board.
	  This board has UART, SPIB with an embedded SPI-Flash chip,
	  I2C, embedded NAND chip, USBD, 100M-Ether on optional debug
	  board, etc.

config MACH_TZ3000RB3
	bool "Support TOSHIBA TZ3000 RB3 platform"
	default y
	help
	  Include support for TOSHIBA RBTZ3000 (CASCADE) board.
	  This board has UART, SD slot, SDIO slot, SPIB with an
	  embedded SPI-Flash chip, I2C, embedded NAND chip, USBH,
	  Gbit-Ether, etc.

config MACH_TZ3000RB4
	bool "Support TOSHIBA TZ3000 RB4 platform"
	default y
	help
	  Include support for TOSHIBA RBTZ3000 (MANASLU) board.
	  This board has UART, SD slot, embedded eMMC chip, SPIB on
	  optional board, I2C, USBH, etc.
	  Boot device can be selected by DIPSW.

config MACH_TZ3000EVA
	bool "Support TOSHIBA TZ3000 EVA board"
	default y
	help
	  Include support for TOSHIBA TZ3000 EVA board.
	  This board has UART, SD slot, SDIO slot, embedded eMMC chip,
	  SPIB with two SPI-Flash socket, SPIM with an embedded
	  SPI-EEPROM chip, I2C with an EEPROM chip, PCIe slot, USBH,
	  Gbit-Ether, etc.

config CACHE_L310_PREFETCH_ENABLE
	bool "Enable Instruction/Data prefetching"
	depends on CACHE_PL310
	default y
	help
	  This option sets Instruction prefetch enable bit (bit29) and
	  Data prefetch enable bit (bit28) in Auxiliary Control
	  Register and Prefetch Control Register of the L2 cache
	  controller.

config TZ3000_SGPIO
	bool "Support TOSHIBA TZ3000 SGPIO"
	help
	  Include support for TOSHIBA TZ3000 SGPIO module.
	  Interrupts from SGPIO are directed to SYSCON module and
	  the SYSCON firmware notify those interrupt events to ARM
	  using mbox.

config TZ3000_DEBUG_UART
	int "Debug UART for TZ3000"
	range 0 4
	default "0"

config TZ3000_UART1
	bool "Support TOSHIBA TZ3000 UART1"
	default n
	help
	  Enable UART1 in TOSHIBA TZ3000.

config TZ3000_UART2
	bool "Support TOSHIBA TZ3000 UART2"
	default n
	help
	  Enable UART2 in TOSHIBA TZ3000.

config TZ3000_UART3
	bool "Support TOSHIBA TZ3000 UART3"
	default n
	help
	  Enable UART3 in TOSHIBA TZ3000.

config TZ3000_UART4
	bool "Support TOSHIBA TZ3000 UART4"
	default n
	help
	  Enable UART4 in TOSHIBA TZ3000.

endmenu
```

## drivers/staging/applite/Kconfig
```kconfig
menuconfig STAGING_APPLITE
	bool "ApP Lite drivers"
	default N
	---help---
	  Enable support for various drivers needed on the ApP Lite platform

if STAGING_APPLITE

source "drivers/staging/applite/ma/Kconfig"

source "drivers/staging/applite/vconv/Kconfig"

source "drivers/staging/applite/veu/Kconfig"

source "drivers/staging/applite/vdu/Kconfig"

source "drivers/staging/applite/syscon/Kconfig"

source "drivers/staging/applite/irecog/Kconfig"

source "drivers/staging/applite/pwm/Kconfig"

source "drivers/staging/applite/yuvc/Kconfig"

source "drivers/staging/applite/emmc/Kconfig"

source "drivers/staging/applite/miragelite/Kconfig"

endif # if STAGING_APPLITE
```

## drivers/staging/applite/emmc/Kconfig
```kconfig
config APPLITE_EMMC
	tristate "TZ2000 eMMC device support"
	depends on ARCH_TZ2000 && BLOCK
	---help---
	  This is the ApP Lite TZ2000 eMMC device.

if APPLITE_EMMC

config APPLITE_EMMC_TEST
	bool "[test] Add test drivers (module only)"
	default n
	depends on APPLITE_EMMC=m

endif # APPLITE_EMMC
```

## drivers/staging/applite/irecog/Kconfig
```kconfig
menuconfig APPLITE_IRECOG
	bool "irecog drivers"
	default N
	depends on ARCH_TZ3000
	---help---
	  Enable support for irecog drivers needed on the ApP Lite platform

if APPLITE_IRECOG

source "drivers/staging/applite/irecog/affine/Kconfig"
source "drivers/staging/applite/irecog/filter/Kconfig"
source "drivers/staging/applite/irecog/hog/Kconfig"
source "drivers/staging/applite/irecog/pyramid/Kconfig"
source "drivers/staging/applite/irecog/gdmac_pyramid/Kconfig"
source "drivers/staging/applite/irecog/gdmac_hand_detect_isolate/Kconfig"
source "drivers/staging/applite/irecog/kmem_allocator/Kconfig"
source "drivers/staging/applite/irecog/hist/Kconfig"

endif # if APPLITE_IRECOG
```

## drivers/staging/applite/irecog/gdmac_hand_detect_isolate/Kconfig
```kconfig
config APPLITE_IRECOG_GDMAC_HAND_DETECT_ISOLATE
        tristate "gdmac hand_detect_isolate driver"
       default n
```

## drivers/staging/applite/irecog/gdmac_pyramid/Kconfig
```kconfig
config APPLITE_IRECOG_GDMAC_PYRAMID
        tristate "gdmac pyramid driver"
       default n
```

## drivers/staging/applite/irecog/kmem_allocator/Kconfig
```kconfig
config APPLITE_IRECOG_KMEM_ALLOCATOR
        tristate "memory driver"
       default n
```

## drivers/staging/applite/irecog/pyramid/Kconfig
```kconfig
config APPLITE_IRECOG_PYRAMID
        tristate "pyramid driver"
       default n
```

## drivers/staging/applite/ma/Kconfig
```kconfig
config APPLITEMA
        tristate "Memory Allocator (applitema) driver"
	select DMA_SHARED_BUFFER
	depends on CMA
```

## drivers/staging/applite/miragelite/Kconfig
```kconfig
config APPLITE_MIRAGELITE
	tristate "MirageLite memory map driver"
	depends on ARCH_TZ3000 && APPLITEMA
	default n
	help
	  This enables the MirageLite(gpu) memory map driver
```

## drivers/staging/applite/pwm/Kconfig
```kconfig
config APPLITE_PWM
	tristate "TZ3000/TZ2000 PWM driver"
	depends on ARCH_TZ3000 || ARCH_TZ2000
	help
         Say yes here to build support for PWM Devices.
```

## drivers/staging/applite/syscon/Kconfig
```kconfig
#
# Toshiba Module Configuration
#

config APPLITE_SYSCON
        tristate "SYSCON driver"
	depends on ARCH_TZ2000 || ARCH_TZ3000
```

## drivers/staging/applite/vconv/Kconfig
```kconfig
#
# Toshiba Module Configuration
#

config APPLITE_VCONV
        tristate "TZ3000 Video Converter (vconv) driver"
	depends on m && ARCH_TZ3000

config APPLITE_VCONV_DEBUG
        bool "vconv debugging"
        depends on APPLITE_VCONV != n
        help
          This is an option for use by developers; most people should
          say N here.  This enables Video Converter Driver debugging.
```

## drivers/staging/applite/vdu/Kconfig
```kconfig
config APPLITE_VDU
       tristate "TZ3000 Video Decoder (vdu) driver"
       default n
       depends on CMA && FW_LOADER && ARCH_TZ3000
       help
         The VDU is a Video Decoder Hardware.
```

## drivers/staging/applite/veu/Kconfig
```kconfig
config APPLITE_VEU
       tristate "TZ3000 Video Encoder (veu) driver"
       default n
       depends on CMA && FW_LOADER && ARCH_TZ3000
       help
         The VEU is a H.264 Video Encoder Hardware.
```

## drivers/staging/applite/yuvc/Kconfig
```kconfig
#
# Toshiba Module Configuration
#

config APPLITE_YUVC
        tristate "TZ2000 YUVC (yuvc) driver"
	depends on m && ARCH_TZ2000

config APPLITE_YUVC_DEBUG
        bool "yuvc debugging"
        depends on APPLITE_YUVC != n
        help
          This is an option for use by developers; most people should
          say N here.  This enables YUVC Driver debugging.
```

## drivers/video/applite/Kconfig
```kconfig
menuconfig FB_APPLITE
	bool "ApP Lite frame buffer device support"
	depends on FB && APPLITE
	help
	  This enables support for ApP Lite frame buffer device.

if FB_APPLITE && FB_APPLITE_BASIC

config FB_TZ2000
	tristate "TZ2000 frame buffer device support"
	depends on FB_APPLITE && ARCH_TZ2000
	select FB_SYS_FILLRECT
	select FB_SYS_COPYAREA
	select FB_SYS_IMAGEBLIT
	select FB_SYS_FOPS
	select APPLITE_PWM
	---help---
	  This is the ApP Lite TZ2000 frame buffer device.

if FB_TZ2000

choice
        prompt "Display setting"
        default FB_TZ2000_DISPLAY_F07A_0102

config FB_TZ2000_DISPLAY_F07A_0102_58
	bool "F07A-0102 (800x480@58.19)"

config FB_TZ2000_DISPLAY_NHD4_3_84
	bool "NHD-4.3 (480x272@84.38)"

config FB_TZ2000_DISPLAY_NHD4_3_59
	bool "NHD-4.3 (480x272@59.94)"

config FB_TZ2000_DISPLAY_NHD4_3_29
	bool "NHD-4.3 (480x272@29.97)"

config FB_TZ2000_DISPLAY_ILI6480G2_59
	bool "ILI6480G2 (480x272@59.94)"
	select FB_TZ2000_USE_PWM0

config FB_TZ2000_DISPLAY_ILI6480G2_29
	bool "ILI6480G2 (480x272@29.97)"
	select FB_TZ2000_USE_PWM0

endchoice

choice
        prompt "Resource mode setting"
        default FB_APPLITE_BASIC_RESOURCE_NORMAL

config FB_APPLITE_BASIC_RESOURCE_NORMAL
	bool "Normal mode (max bpp=32 tripple buffers)"
	depends on CMA

config FB_APPLITE_BASIC_RESOURCE_MINIMAL
	bool "Minimal mode with DRAM (bpp=16 single buffer only)"

config FB_APPLITE_BASIC_RESOURCE_MINIMAL_SRAM
	bool "Minimal mode with SRAM (default: bpp=16 single buffer)"

endchoice

config FB_APPLITE_BASIC_GFX_MERGED
	bool "Merge GFX driver."
	depends on FB_TZ2000
	default y
	---help---
	  Merge the tz2000gfx GFX driver into the tz2000fb FrameBuffer driver.

config FB_TZ2000_USE_PWM0
	bool "Use PWM[0]"

endif # FB_TZ2000

config FB_TZ3000
	tristate "TZ3000 frame buffer device support"
	depends on FB_APPLITE && ARCH_TZ3000 && CMA
	select FB_SYS_FILLRECT
	select FB_SYS_COPYAREA
	select FB_SYS_IMAGEBLIT
	select FB_SYS_FOPS
	---help---
	  This is the ApP Lite TZ3000 frame buffer device.

endif # FB_APPLITE_BASIC

if FB_APPLITE && FB_APPLITE_STANDARD

config FB_TZ2000
	tristate "TZ2000 frame buffer device support"
	depends on FB_APPLITE && ARCH_TZ2000 && CMA
	select FB_SYS_FILLRECT
	select FB_SYS_COPYAREA
	select FB_SYS_IMAGEBLIT
	select FB_SYS_FOPS
	---help---
	  This is the ApP Lite TZ2000 frame buffer device.

if FB_TZ2000
choice
	prompt "Panel setting"
	default FB_APPLITE_PANEL_F07A_0102

config FB_APPLITE_PANEL_F07A_0102
	bool "F07A-0102 (800x480@58.19)"

config FB_APPLITE_PANEL_NHD4_3
	bool "NHD-4.3 (480x272@84.38)"

config FB_APPLITE_PANEL_NHD4_3_59
	bool "NHD-4.3 (480x272@59.94)"

config FB_APPLITE_PANEL_NHD4_3_29
	bool "NHD-4.3 (480x272@29.97)"

config FB_APPLITE_PANEL_ILI6480G2_59
	bool "ILI6480G2 (480x272@59.94)"
	select APPLITE_PWM

config FB_APPLITE_PANEL_ILI6480G2_29
	bool "ILI6480G2 (480x272@29.97)"
	select APPLITE_PWM

endchoice
endif # FB_TZ2000

config FB_TZ3000
	tristate "TZ3000 frame buffer device support"
	depends on FB_APPLITE && ARCH_TZ3000 && CMA
	select FB_SYS_FILLRECT
	select FB_SYS_COPYAREA
	select FB_SYS_IMAGEBLIT
	select FB_SYS_FOPS
	---help---
	  This is the ApP Lite TZ3000 frame buffer device.

config D2DP
	bool "DSI to Display Port setting"
	depends on FB_TZ3000
	default y
	---help---
	  This is the setting of DSI to Display Port.

config APPLITEFB_ENABLE_LAYER
	int "number of layer"
	depends on FB_TZ2000 || FB_TZ3000
	range 1 2 if FB_TZ3000
	range 1 5 if FB_TZ2000
	default 1
	---help---
	  number of enable layer.

config APPLITEFB_DEFAULT_FB_MAGNIFICATION
	int "number of FrameBuffer area"
	depends on FB_TZ2000 || FB_TZ3000
	default "3"
	help
	  The  number of FrameBuffer area that are supported.
	  Default is 3.

config APPLITEFB_DEFAULT_GFX_SIZE
	int "Size of GFX area in Mega Bytes"
	depends on FB_TZ2000
	default "16"
	help
	  Size of GFX area that are supported.
	  Default is 16(16MB).

endif # FB_APPLITE_STANDARD

choice
        prompt "Implementation"
        default FB_APPLITE_STANDARD

config FB_APPLITE_STANDARD
	bool "Standard implementation"

config FB_APPLITE_BASIC
	bool "Basic implementation"

endchoice
```

## sound/soc/applite/Kconfig
```kconfig
config SND_APPLITE_SOC
	tristate "SoC Audio for TZxxx"
	depends on APPLITE && (ARCH_TZ2000 || ARCH_TZ3000)
	select SND_SOC_TLV320ADC3xxx if I2C
	select SND_SOC_TLV320AIC3110 if I2C
	help
	  Say Y or M if you want to add support for codecs attached to
          the ApP Lite I2S interface.

choice
	prompt "Default Audio Clock"
	default AUDIO_CLOCK_245760000HZ
	depends on SND_APPLITE_SOC

config AUDIO_CLOCK_245760000HZ
        bool "Audio Clock is 24.5760MHz"

config AUDIO_CLOCK_184320000HZ
        bool "Audio Clock is 18.4320MHz"

config AUDIO_CLOCK_122880000HZ
        bool "Audio Clock is 12.2880MHz"

config AUDIO_CLOCK_112896000HZ
        bool "Audio CLock is 11.2896MHz"

endchoice

choice
	prompt "Default Audio Format"
	default AUDIO_FORMAT_I2S
	depends on SND_APPLITE_SOC

config AUDIO_FORMAT_I2S
	bool "Audio Format is I2S"

config AUDIO_FORMAT_LR
	bool "Audio Format is Left-, Right-Justified"

endchoice

config AUDIO_PERIOD_BYTES
	int "Audio number of maximum period bytes(1 to 8-Kbyte)"
	depends on SND_APPLITE_SOC
	range 1 8 if SND_APPLITE_SOC
	default 8
	---help---
	  number of period bytes(Kbyte).
```
